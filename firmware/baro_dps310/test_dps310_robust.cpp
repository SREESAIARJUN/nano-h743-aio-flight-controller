// Nano H743 AIO - DPS310 robust driver regression tests (Revision 12.0)
// Build + run:  make -C firmware/baro_dps310 test
//
// A register-level DPS310 model sits behind a simulated I2C1 with
// deterministic fault injection (SDA bit flips on read data, write data and
// the register pointer, NACK bursts, arbitration loss, bus errors, a slave
// holding SDA low for k clocks, a bit-level slave hung mid-read / in a
// write ACK slot, sensor power-on reset). Raw ADC values are
// generated by inverting the datasheet compensation for a known P/T, using the
// oversampling the SIMULATED DEVICE is actually configured for, so a driver
// that loses track of the real configuration gets visibly wrong numbers.
#include "dps310_robust.h"

#include <cmath>
#include <cstdio>
#include <cstdlib>
#include <cstring>

using namespace nano_baro;

static int g_fail = 0;
static int g_pass = 0;
#define CHECK(cond, ...) do { if (cond) { g_pass++; } else { g_fail++; \
    std::printf("  [FAIL] %s:%d ", __FILE__, __LINE__); std::printf(__VA_ARGS__); std::printf("\n"); } } while (0)

static uint32_t g_rng = 0xD9531001u;
static double urand()
{
    g_rng = g_rng * 1664525u + 1013904223u;
    return double(g_rng >> 8) / 16777216.0;
}
static double nrand()
{
    double s = 0;
    for (int i = 0; i < 12; i++) s += urand();
    return s - 6.0;
}
static uint32_t irand(uint32_t n) { return uint32_t(urand() * double(n)) % n; }

// Synthetic but plausible coefficient set (magnitudes typical of DPS310 parts:
// c0 ~ 200, c1 ~ -260, c00 ~ 8e4, c10 ~ -6e4). Not taken from a real unit.
static Coefficients known_coefs()
{
    Coefficients c;
    c.c0 = 200; c.c1 = -260;
    c.c00 = 80000; c.c10 = -60000;
    c.c01 = -2500; c.c11 = 1500; c.c20 = -8000; c.c21 = 200; c.c30 = -1000;
    return c;
}

// double-precision forward model
static double fwd_p(const Coefficients& c, double xp, double xt)
{
    return c.c00 + xp * (c.c10 + xp * (c.c20 + xp * c.c30)) + xt * c.c01 + xt * xp * (c.c11 + xp * c.c21);
}
static double fwd_t(const Coefficients& c, double xt) { return c.c0 * 0.5 + c.c1 * xt; }
static int32_t inv_t(const Coefficients& c, double T, int32_t kt)
{
    return int32_t(std::lround((T - c.c0 * 0.5) / c.c1 * kt));
}
static int32_t inv_p(const Coefficients& c, double P, double xt, int32_t kp)
{
    double x = (P - c.c00 - xt * c.c01) / (c.c10 + xt * c.c11);
    for (int i = 0; i < 30; i++) {
        const double f = fwd_p(c, x, xt) - P;
        const double d = c.c10 + 2 * c.c20 * x + 3 * c.c30 * x * x + xt * (c.c11 + 2 * c.c21 * x);
        x -= f / d;
    }
    return int32_t(std::lround(x * kp));
}
static void put24(uint8_t* b, int32_t v)
{
    const uint32_t u = uint32_t(v) & 0xFFFFFFu;
    b[0] = uint8_t(u >> 16); b[1] = uint8_t(u >> 8); b[2] = uint8_t(u);
}

// ---------------------------------------------------------------------------
// DPS310 register model
// ---------------------------------------------------------------------------
struct SimDps310 {
    uint8_t r[256];
    Coefficients coef = known_coefs();
    uint8_t srce = 0x80;
    bool fix_applied = false;
    bool needs_fix = true;            // part shows the temperature defect without the fix
    uint64_t now = 0;
    uint64_t boot_until = 0;
    int quirk_reads = 0;              // PRODUCT_ID reads that return 0x00
    bool quirk_until_reset = false;
    uint32_t por_count = 0, soft_resets = 0;
    uint8_t wlog_reg[512], wlog_val[512];
    uint32_t nwlog = 0;

    SimDps310() { por(); now = 100000; }
    void load_nvm()
    {
        encode_coefficients(coef, &r[reg::COEF]);
        r[reg::COEF_SRCE] = uint8_t(srce | 0x05);
        r[reg::PRODUCT_ID] = PRODUCT_ID_VALUE;
    }
    void por()
    {
        std::memset(r, 0, sizeof(r));
        load_nvm();
        fix_applied = false;
        boot_until = now + 40000;
        por_count++;
    }
    void soft_reset()
    {
        por();
        por_count--;
        soft_resets++;
        if (quirk_until_reset) { quirk_until_reset = false; quirk_reads = 0; }
    }
    uint8_t read(uint8_t a)
    {
        if (a == reg::PRODUCT_ID && (quirk_reads > 0 || quirk_until_reset)) {
            if (quirk_reads > 0) quirk_reads--;
            return 0x00;
        }
        if (a == reg::MEAS_CFG) {
            uint8_t v = r[a];
            if (now >= boot_until) v = uint8_t(v | MEAS_COEF_RDY | MEAS_SENSOR_RDY);
            return v;
        }
        const uint8_t v = r[a];
        if (a == reg::PSR_B2) r[reg::MEAS_CFG] = uint8_t(r[reg::MEAS_CFG] & ~MEAS_PRS_RDY);
        if (a == reg::TMP_B2) r[reg::MEAS_CFG] = uint8_t(r[reg::MEAS_CFG] & ~MEAS_TMP_RDY);
        return v;
    }
    void write(uint8_t a, uint8_t v)
    {
        if (nwlog < 512) { wlog_reg[nwlog] = a; wlog_val[nwlog] = v; nwlog++; }
        switch (a) {
        case reg::RESET:
            if ((v & 0x0F) == SOFT_RESET_CMD) soft_reset();
            return;
        case reg::MEAS_CFG:
            r[a] = uint8_t((r[a] & 0xF8) | (v & 0x07));
            return;
        case reg::PRS_CFG: case reg::TMP_CFG: case reg::CFG_REG:
        case reg::FIX_A: case reg::FIX_B:
            r[a] = v;
            return;
        case reg::FIX_C:
            r[a] = v;
            if (v == 0x02 && r[reg::FIX_A] == 0xA5 && r[reg::FIX_B] == 0x96) fix_applied = true;
            return;
        default:
            return;   // read-only / not modelled
        }
    }
    // Background-mode conversion of the true (P, T) with the CURRENT device config.
    bool produce(double P, double T)
    {
        if ((r[reg::MEAS_CFG] & 7) != 7 || now < boot_until) return false;
        const uint8_t pprc = r[reg::PRS_CFG] & 0x0F, tprc = r[reg::TMP_CFG] & 0x0F;
        const int32_t kp = scale_factor(pprc), kt = scale_factor(tprc);
        if (!kp || !kt) return false;
        double t_meas = T;
        if (needs_fix && !fix_applied) t_meas += 25.0;                 // DPS310 temperature defect
        if ((r[reg::TMP_CFG] & 0x80) != srce) t_meas -= 15.0;          // wrong temperature sensor
        int32_t traw = inv_t(coef, t_meas, kt);
        const double xt_true = double(inv_t(coef, T, kt)) / kt;
        int32_t praw = inv_p(coef, P, xt_true, kp);
        if (needs_shift(pprc) && !(r[reg::CFG_REG] & CFG_P_SHIFT)) praw ^= 0x2A5A5;  // result overflow
        if (needs_shift(tprc) && !(r[reg::CFG_REG] & CFG_T_SHIFT)) traw ^= 0x2A5A5;
        put24(&r[reg::PSR_B2], praw);
        put24(&r[reg::TMP_B2], traw);
        r[reg::MEAS_CFG] = uint8_t(r[reg::MEAS_CFG] | MEAS_PRS_RDY | MEAS_TMP_RDY);
        return true;
    }
};

// ---------------------------------------------------------------------------
// Simulated I2C1 + GPIO with fault injection
// ---------------------------------------------------------------------------
// Bit-level I2C slave state machine (UM10204 s3.1): what the DPS310 (or any
// slave on I2C1) does with SDA while the master bit-bangs a bus clear.
//  - TX  (slave-transmitter, read data): drives bit `pos` (MSB first) of `byte`
//        while pos < 8, changes it ONLY on SCL falling edges, releases SDA in the
//        master-ACK slot (pos 8) and samples it on the SCL rising edge: SDA high
//        = NACK -> stops transmitting (waits for STOP); low = ACK -> next byte.
//  - RX  (slave-receiver, write data): samples SDA on rising edges, drives the
//        ACK (SDA low) during pos 8, releases on the falling edge that ends it.
//  - ADDR (after a START): like RX but ACKs only its own address 0x76, then
//        becomes TX (R) or RX (W).
//  - START (SDA falling while SCL high) at any bit position -> ADDR, pos 0;
//    STOP (SDA rising while SCL high) -> IDLE, transaction closed.
struct BitSlave {
    enum Mode : uint8_t { IDLE = 0, TX, RX, ADDR };
    Mode mode = IDLE;
    uint8_t byte = 0, sr = 0, pos = 0;
    bool in_txn = false;        // a STOP is still owed to this slave
    uint32_t starts = 0, stops = 0, nacks = 0, acks = 0;
    void reset() { *this = BitSlave(); }
    bool drives_low() const
    {
        switch (mode) {
        case TX:   return pos < 8 && !((byte >> (7 - pos)) & 1u);
        case RX:   return pos == 8;
        case ADDR: return pos == 8 && (sr >> 1) == I2C_ADDR_SDO_GND;
        default:   return false;
        }
    }
    void scl_rise(bool sda)
    {
        if (mode == TX && pos == 8) {
            if (sda) { nacks++; mode = IDLE; } else acks++;     // IDLE but in_txn until STOP
        } else if ((mode == RX || mode == ADDR) && pos < 8) {
            sr = uint8_t((sr << 1) | (sda ? 1u : 0u));
        }
    }
    void scl_fall()
    {
        if (mode == IDLE) return;
        if (++pos <= 8) return;
        pos = 0;
        if (mode == TX) byte = uint8_t(byte * 37u + 11u);       // next register byte (any pattern)
        else if (mode == ADDR) {
            if ((sr >> 1) == I2C_ADDR_SDO_GND) { mode = (sr & 1u) ? TX : RX; byte = 0x5A; }
            else mode = IDLE;
        }
        sr = 0;
    }
    void start() { mode = ADDR; pos = 0; sr = 0; in_txn = true; starts++; }
    void stop() { mode = IDLE; pos = 0; in_txn = false; stops++; }
};

struct Flip { bool on_read; uint8_t reg; uint32_t occurrence; uint8_t byte; uint8_t bit; bool used; };

struct SimBus : I2cTransport, I2cBusGpio {
    SimDps310& d;
    bool present = true;
    uint32_t txns = 0;
    uint32_t read_occ[256], write_occ[256];
    Flip flips[64];
    uint32_t nflips = 0;
    uint32_t nack_burst = 0;
    uint8_t addr_once_reg = 0, addr_once_xor = 0;   // corrupt the register pointer of one transaction
    bool addr_once_used = false;
    uint32_t stuck_clocks = 0;          // >0: slave holds SDA low until this many SCL pulses
    // random fault model (per transaction / per data bit)
    double ber = 0, p_nack = 0, p_arb = 0, p_berr = 0, p_addr = 0, p_stuck = 0, p_por = 0;
    uint32_t rnd_flips = 0, rnd_stuck = 0, rnd_por = 0;
    // GPIO state
    bool bitbang = false, m_scl = true, m_sda = true;
    uint32_t clock_pulses = 0, stops = 0, bitbang_sessions = 0;
    BitSlave bs;                        // bit-level slave (hung mid-read / mid-write ACK)
    uint32_t rnd_bit_hangs = 0;

    explicit SimBus(SimDps310& dev) : d(dev)
    {
        std::memset(read_occ, 0, sizeof(read_occ));
        std::memset(write_occ, 0, sizeof(write_occ));
    }
    void add_flip(bool on_read, uint8_t reg, uint32_t occ, uint8_t byte, uint8_t bit)
    {
        if (nflips < 64) flips[nflips++] = Flip{on_read, reg, occ, byte, bit, false};
    }
    void clear_flips() { nflips = 0; }

    I2cStatus pre(uint8_t& reg)
    {
        txns++;
        if (stuck_clocks) return I2cStatus::TIMEOUT;        // STM32 sees BUSY, transfer times out
        if (bs.in_txn || !m_scl) {
            if (bs.drives_low()) return I2cStatus::TIMEOUT; // SDA held low: BUSY
            bs.reset(); m_scl = true;                       // peripheral START/STOP resyncs it
        }
        if (!present) return I2cStatus::NACK;
        if (nack_burst) { nack_burst--; return I2cStatus::NACK; }
        if (p_por > 0 && urand() < p_por) { d.por(); rnd_por++; }
        if (p_stuck > 0 && urand() < p_stuck) {
            rnd_stuck++;
            if (irand(2)) { stuck_clocks = 1 + irand(8); return I2cStatus::TIMEOUT; }
            // bit-level hang: slave mid-read data byte or in a write ACK slot, SDA low
            for (;;) {
                const bool rdm = irand(2) != 0;
                hang(rdm ? BitSlave::TX : BitSlave::RX, uint8_t(rdm ? irand(8) : 8), uint8_t(irand(256)),
                     irand(2) != 0, false);
                if (bs.drives_low()) break;
            }
            rnd_bit_hangs++;
            return I2cStatus::TIMEOUT;
        }
        if (p_nack > 0 && urand() < p_nack) return I2cStatus::NACK;
        if (p_arb > 0 && urand() < p_arb) return I2cStatus::ARB_LOST;
        if (p_berr > 0 && urand() < p_berr) return I2cStatus::BUS_ERROR;
        if (addr_once_xor && !addr_once_used && reg == addr_once_reg) { reg = uint8_t(reg ^ addr_once_xor); addr_once_used = true; }
        if (p_addr > 0 && urand() < p_addr) reg = uint8_t(reg ^ (1u << irand(8)));   // pointer byte hit
        return I2cStatus::OK;
    }
    I2cStatus read_registers(uint8_t first_reg, uint8_t* buf, size_t len) override
    {
        const uint8_t asked = first_reg;
        const I2cStatus st = pre(first_reg);
        if (st != I2cStatus::OK) return st;
        const uint32_t occ = ++read_occ[asked];
        for (size_t i = 0; i < len; i++) buf[i] = d.read(uint8_t(first_reg + i));
        for (uint32_t k = 0; k < nflips; k++) {
            Flip& f = flips[k];
            if (!f.used && f.on_read && f.reg == asked && f.occurrence == occ && f.byte < len) {
                buf[f.byte] = uint8_t(buf[f.byte] ^ (1u << f.bit));
                f.used = true;
            }
        }
        if (ber > 0) {
            for (size_t i = 0; i < len; i++)
                for (int b = 0; b < 8; b++)
                    if (urand() < ber) { buf[i] = uint8_t(buf[i] ^ (1u << b)); rnd_flips++; }
        }
        return I2cStatus::OK;
    }
    I2cStatus write_register(uint8_t reg, uint8_t value) override
    {
        const uint8_t asked = reg;
        const I2cStatus st = pre(reg);
        if (st != I2cStatus::OK) return st;
        const uint32_t occ = ++write_occ[asked];
        for (uint32_t k = 0; k < nflips; k++) {
            Flip& f = flips[k];
            if (!f.used && !f.on_read && f.reg == asked && f.occurrence == occ) {
                value = uint8_t(value ^ (1u << f.bit));
                f.used = true;
            }
        }
        if (ber > 0)
            for (int b = 0; b < 8; b++)
                if (urand() < ber) { value = uint8_t(value ^ (1u << b)); rnd_flips++; }
        d.write(reg, value);
        return I2cStatus::OK;
    }
    void delay_us(uint32_t us) override { d.now += us; }

    // Put the bit-level slave in a hung state: the master died in `mode` at bit
    // `pos` (0..7 data, 8 = ACK slot) of `byte`. scl_low: died right after the
    // falling edge into that bit; else after the following rising edge (the
    // slave has already sampled it). master_sda_low: the master was driving
    // SDA low (its ACK of a read byte) when it died.
    void hang(BitSlave::Mode mode, uint8_t pos, uint8_t byte, bool scl_low, bool master_sda_low)
    {
        bs.reset();
        bs.mode = mode; bs.pos = pos; bs.byte = byte; bs.in_txn = true;
        if (mode != BitSlave::TX) bs.sr = pos ? uint8_t(byte >> (8 - pos)) : 0;
        m_sda = !master_sda_low;
        m_scl = true;
        if (scl_low) m_scl = false;
        else bs.scl_rise(sda_line());
    }

    // GPIO (open drain). Legacy model: slave releases SDA after `stuck_clocks`
    // SCL rising edges. Bit-level model: BitSlave above. clock_pulses counts
    // only the driver's SCL pulses, not the line release in begin_bitbang().
    bool sda_line() const { return m_sda && stuck_clocks == 0 && !bs.drives_low(); }
    void scl_edge(bool rel, bool count)
    {
        if (!m_scl && rel) {
            if (count) clock_pulses++;
            if (stuck_clocks && stuck_clocks < 1000000u) stuck_clocks--;
            m_scl = true;
            bs.scl_rise(sda_line());
        } else if (m_scl && !rel) {
            m_scl = false;
            bs.scl_fall();
        }
    }
    void begin_bitbang() override
    {
        bitbang = true; bitbang_sessions++;
        set_sda(true);                 // pins switch to released open-drain, SDA first
        scl_edge(true, false);
    }
    void end_bitbang() override { set_sda(true); scl_edge(true, false); bitbang = false; }
    void set_scl(bool rel) override { scl_edge(rel, true); }
    void set_sda(bool rel) override
    {
        const bool before = sda_line();
        m_sda = rel;
        const bool after = sda_line();
        if (m_scl && before && !after) bs.start();                  // START
        if (m_scl && !before && after) { stops++; bs.stop(); }       // STOP
    }
    bool read_scl() override { return m_scl; }
    bool read_sda() override { return sda_line(); }
};

struct Rig {
    SimDps310 dev;
    SimBus bus{dev};
    Config cfg;
    Dps310 drv;
    explicit Rig(const Config& c = Config()) : cfg(c), drv(bus, &bus, c) {}
    uint32_t now() const { return uint32_t(dev.now); }
    // one 32 Hz period: device converts, driver polls
    Update step(double P, double T, bool produce = true)
    {
        dev.now += 31250;
        if (produce) dev.produce(P, T);
        return drv.update(now());
    }
};

static const double P0 = 101325.0, T0 = 25.0;

// ArduPilot AP_Baro_DPS280 transcriptions (read_calibration + calculate_PT)
struct ApCal { int16_t C0, C1; int32_t C00, C10; int16_t C01, C11, C20, C21, C30; };
static void ap_fix16(int16_t& v, uint8_t bits) { if (v > int16_t((1U << (bits - 1)) - 1)) v = int16_t(v - (1U << bits)); }
static void ap_fix32(int32_t& v, uint8_t bits) { if (v > int32_t((1U << (bits - 1)) - 1)) v = int32_t(v - int32_t(1U << bits)); }
static ApCal ap_parse(const uint8_t* buf)
{
    ApCal c;
    c.C0  = int16_t((buf[0] << 4) + ((buf[1] >> 4) & 0x0F));
    c.C1  = int16_t(buf[2] + ((buf[1] & 0x0F) << 8));
    c.C00 = ((buf[4] << 4) + (buf[3] << 12)) + ((buf[5] >> 4) & 0x0F);
    c.C10 = ((buf[5] & 0x0F) << 16) + buf[7] + (buf[6] << 8);
    c.C01 = int16_t(buf[9] + (buf[8] << 8));
    c.C11 = int16_t(buf[11] + (buf[10] << 8));
    c.C20 = int16_t(buf[13] + (buf[12] << 8));
    c.C21 = int16_t(buf[15] + (buf[14] << 8));
    c.C30 = int16_t(buf[17] + (buf[16] << 8));
    ap_fix16(c.C0, 12); ap_fix16(c.C1, 12); ap_fix32(c.C00, 20); ap_fix32(c.C10, 20);
    return c;
}
static void ap_calculate_PT(const ApCal& cal, int32_t UT, int32_t UP, float& pressure, float& temperature)
{
    const float scaling_16 = 1.0f / 253952;
    const float temp_scaled = float(UT) * scaling_16;
    temperature = float(cal.C0) * 0.5f + float(cal.C1) * temp_scaled;
    const float press_scaled = float(UP) * scaling_16;
    pressure = float(cal.C00);
    pressure += press_scaled * (float(cal.C10) + press_scaled * (float(cal.C20) + press_scaled * float(cal.C30)));
    pressure += temp_scaled * float(cal.C01);
    pressure += temp_scaled * press_scaled * (float(cal.C11) + press_scaled * float(cal.C21));
}

// ---------------------------------------------------------------------------
static void test_bits()
{
    std::printf("T1 24-bit raw and 12/16/20-bit coefficient sign extension\n");
    CHECK(sign_extend(0x7FF, 12) == 2047 && sign_extend(0x800, 12) == -2048 && sign_extend(0xFFF, 12) == -1, "12-bit");
    CHECK(sign_extend(0x7FFFF, 20) == 524287 && sign_extend(0x80000, 20) == -524288, "20-bit");
    CHECK(sign_extend(0x8000, 16) == -32768 && sign_extend(0x7FFF, 16) == 32767, "16-bit");
    CHECK(sign_extend(0xFFFFFFFFu, 32) == -1 && sign_extend(0x80000000u, 32) == INT32_MIN, "32-bit");
    const uint8_t a[3] = {0x80, 0x00, 0x00}, b[3] = {0x7F, 0xFF, 0xFF}, c[3] = {0xFF, 0xFF, 0xFE};
    CHECK(raw24(a) == -8388608 && raw24(b) == 8388607 && raw24(c) == -2, "raw24");
    int bad = 0, ap_bad = 0;
    for (int n = 0; n < 20000; n++) {
        Coefficients k;
        k.c0 = int32_t(irand(4096)) - 2048; k.c1 = int32_t(irand(4096)) - 2048;
        k.c00 = int32_t(irand(1u << 20)) - (1 << 19); k.c10 = int32_t(irand(1u << 20)) - (1 << 19);
        k.c01 = int32_t(irand(65536)) - 32768; k.c11 = int32_t(irand(65536)) - 32768;
        k.c20 = int32_t(irand(65536)) - 32768; k.c21 = int32_t(irand(65536)) - 32768;
        k.c30 = int32_t(irand(65536)) - 32768;
        uint8_t blk[18];
        encode_coefficients(k, blk);
        const Coefficients p = parse_coefficients(blk);
        if (p != k) bad++;
        const ApCal ap = ap_parse(blk);
        if (ap.C0 != p.c0 || ap.C1 != p.c1 || ap.C00 != p.c00 || ap.C10 != p.c10 || ap.C01 != p.c01 ||
            ap.C11 != p.c11 || ap.C20 != p.c20 || ap.C21 != p.c21 || ap.C30 != p.c30) ap_bad++;
    }
    CHECK(bad == 0, "encode/parse round trip: %d mismatches", bad);
    CHECK(ap_bad == 0, "parse != ArduPilot read_calibration on %d blocks", ap_bad);
    std::printf("      20000 random blocks: round-trip and ArduPilot-parse identical\n");
}

static void test_scale_budget()
{
    std::printf("T2 kP/kT scale factors, background-mode budget, rate gate\n");
    const int32_t k[8] = {524288, 1572864, 3670016, 7864320, 253952, 516096, 1040384, 2088960};
    bool ok = true;
    for (uint8_t i = 0; i < 8; i++) ok = ok && scale_factor(i) == k[i];
    CHECK(ok && scale_factor(8) == 0, "scale table");
    CHECK(!needs_shift(3) && needs_shift(4), "shift rule > 8x");
    const uint32_t ap = background_budget_us(5, 4, 5, 4);
    const uint32_t ours = background_budget_us(5, 4, 2, 0);
    std::printf("      ArduPilot PCONF=0x54 TCONF=0x54: %.1f ms/s (limit 1000) -> %s\n", ap / 1000.0,
                ap >= 1000000u ? "OVER BUDGET" : "ok");
    std::printf("      Rev 12 plan P 32 Hz x16 + T 4 Hz x1: %.1f ms/s\n", ours / 1000.0);
    CHECK(ap == 1766400u, "AP budget %u", unsigned(ap));
    CHECK(ours == 897600u, "our budget %u", unsigned(ours));
    Config bad;
    bad.tmp_rate = 5; bad.tmp_prc = 4;
    SimDps310 dev; SimBus bus(dev); Dps310 drv(bus, &bus, bad);
    CHECK(!drv.init(0) && (drv.health().flags & F_BUDGET_FAIL), "over-budget config must be refused");
    Config c;
    const float g = max_dp_dh(c);
    const float gate = c.max_vz_mps * g * 0.03125f + c.gate_margin_pa;
    std::printf("      dP/dh max %.2f Pa/m, gate at 32 Hz = %.1f Pa (%.0f m/s), 3 m step at sea level = %.1f Pa\n",
                double(g), double(gate), double(c.max_vz_mps), 3 * 12.01);
    CHECK(std::fabs(g - 17.97f) < 0.05f, "dP/dh %f", double(g));
}

static void test_compensation()
{
    std::printf("T3 compensation vs inverted datasheet formula, ArduPilot calculate_PT cross-check\n");
    const Coefficients c = known_coefs();
    double worst_ref = 0, worst_true = 0, worst_t = 0;
    for (uint8_t prc = 0; prc < 8; prc++) {
        const int32_t kp = scale_factor(prc), kt = scale_factor(prc);
        for (double P = 30000; P <= 120000; P += 1500) {
            for (double T = -40; T <= 85; T += 12.5) {
                const int32_t traw = inv_t(c, T, kt);
                const double xt = double(traw) / kt;
                const int32_t praw = inv_p(c, P, xt, kp);
                float p, t;
                compensate(c, praw, traw, kp, kt, p, t);
                const double pref = fwd_p(c, double(praw) / kp, xt);
                worst_ref = std::fmax(worst_ref, std::fabs(double(p) - pref));
                worst_true = std::fmax(worst_true, std::fabs(double(p) - P));
                worst_t = std::fmax(worst_t, std::fabs(double(t) - fwd_t(c, xt)));
            }
        }
    }
    std::printf("      1x..128x, 300..1200 hPa, -40..85 C: |float-double| %.4f Pa, |P-Ptrue| %.3f Pa, |T| %.5f C\n",
                worst_ref, worst_true, worst_t);
    CHECK(worst_ref < 0.05, "float vs double %f", worst_ref);
    CHECK(worst_true < 0.6, "vs truth %f (quantisation at 1x = 0.11 Pa/LSB)", worst_true);
    CHECK(worst_t < 0.001, "temperature %f", worst_t);
    uint8_t blk[18];
    encode_coefficients(c, blk);
    const ApCal ap = ap_parse(blk);
    double worst_ap = 0;
    for (double P = 30000; P <= 120000; P += 777) {
        const int32_t traw = inv_t(c, 20.0, 253952);
        const int32_t praw = inv_p(c, P, double(traw) / 253952, 253952);
        float p1, t1, p2, t2;
        compensate(c, praw, traw, 253952, 253952, p1, t1);
        ap_calculate_PT(ap, traw, praw, p2, t2);
        worst_ap = std::fmax(worst_ap, std::fabs(double(p1 - p2)));
    }
    CHECK(worst_ap < 0.05, "vs ArduPilot %f", worst_ap);
    // what upstream does if the sensor is NOT at 16x: wrong kP
    const int32_t traw = inv_t(c, 25.0, 524288);
    const int32_t praw = inv_p(c, P0, double(traw) / 524288, 524288);
    float pw, tw;
    ap_calculate_PT(ap, traw, praw, pw, tw);
    std::printf("      16x/16x vs ArduPilot: max %.4f Pa; a 1x sample through the hard-coded 16x scale reads %.0f Pa / %.1f C\n",
                worst_ap, double(pw), double(tw));
}

static void test_probe()
{
    std::printf("T4 probe, boot WHOAMI quirk (I2C: no CS to toggle), absent device\n");
    {
        Rig g;
        CHECK(g.drv.init(g.now()), "clean init");
        CHECK(g.drv.health().whoami_bad == 0 && g.drv.health().quirk_resets == 0, "no quirk on clean part");
    }
    {
        Rig g;
        g.dev.quirk_reads = 3;
        CHECK(g.drv.init(g.now()), "transient quirk handled by re-read");
        CHECK(g.drv.health().whoami_bad == 3 && g.dev.soft_resets == 0, "bad=%u resets=%u",
              unsigned(g.drv.health().whoami_bad), unsigned(g.dev.soft_resets));
    }
    {
        Rig g;
        g.dev.quirk_until_reset = true;
        CHECK(g.drv.init(g.now()), "latched quirk escaped by soft reset");
        CHECK(g.dev.soft_resets == 1 && g.drv.health().quirk_resets == 1, "soft reset issued once");
        std::printf("      latched quirk: %u bad reads, %u soft reset, init OK\n",
                    unsigned(g.drv.health().whoami_bad), unsigned(g.dev.soft_resets));
    }
    {
        Rig g;
        g.bus.present = false;
        CHECK(!g.drv.init(g.now()), "absent device fails");
        CHECK(!(g.drv.health().flags & F_PRESENT) && g.dev.soft_resets == 0, "no reset to absent device");
        int ups = 0;
        for (int i = 0; i < 40; i++) if (g.step(P0, T0) == Update::NEW_SAMPLE) ups++;
        CHECK(ups == 0, "absent device produced samples");
        std::printf("      absent: %u NACKs, %u recoveries over 1.25 s (holdoff %u ms)\n",
                    unsigned(g.drv.health().nack), unsigned(g.drv.health().recoveries),
                    unsigned(g.cfg.recovery_holdoff_us / 1000));
        CHECK(g.drv.health().recoveries <= 14, "recovery rate bounded by holdoff");
    }
}

static void test_init_sequence()
{
    std::printf("T5 init: COEF_SRCE -> TMP_EXT, shifts, temperature fix, read-back\n");
    for (int src = 0; src < 2; src++) {
        Rig g;
        g.dev.srce = src ? 0x80 : 0x00;
        g.dev.load_nvm();
        CHECK(g.drv.init(g.now()), "init");
        CHECK(g.dev.r[reg::TMP_CFG] == uint8_t(g.dev.srce | 0x20), "TMP_CFG 0x%02X", g.dev.r[reg::TMP_CFG]);
        CHECK(g.dev.r[reg::PRS_CFG] == 0x54 && g.dev.r[reg::CFG_REG] == CFG_P_SHIFT, "PRS_CFG/CFG_REG");
        CHECK((g.dev.r[reg::MEAS_CFG] & 7) == 7 && g.dev.fix_applied, "background + fix");
        // fix sequence order
        const uint8_t want[5][2] = {{0x0E, 0xA5}, {0x0F, 0x96}, {0x62, 0x02}, {0x0E, 0x00}, {0x0F, 0x00}};
        bool seq = false;
        for (uint32_t i = 0; i + 5 <= g.dev.nwlog && !seq; i++) {
            bool m = true;
            for (int j = 0; j < 5; j++) m = m && g.dev.wlog_reg[i + j] == want[j][0] && g.dev.wlog_val[i + j] == want[j][1];
            seq = m;
        }
        CHECK(seq, "temperature fix sequence");
        int n = 0; double we = 0, wt = 0;
        for (int i = 0; i < 20; i++) {
            if (g.step(P0, T0) == Update::NEW_SAMPLE) {
                n++;
                we = std::fmax(we, std::fabs(g.drv.last().pressure_pa - P0));
                wt = std::fmax(wt, std::fabs(g.drv.last().temperature_c - T0));
            }
        }
        CHECK(n >= 17 && we < 0.5 && wt < 0.01, "src %d: n=%d errP=%f errT=%f", src, n, we, wt);
        std::printf("      COEF_SRCE=0x%02X: TMP_CFG=0x%02X, %d/20 samples, |dP| %.3f Pa, |dT| %.4f C\n",
                    g.dev.srce, g.dev.r[reg::TMP_CFG], n, we, wt);
    }
    // 32x temperature -> T_SHIFT required
    Config c; c.tmp_prc = 5; c.tmp_rate = 0;   // 1 Hz x32 = 53.2 ms; total 936.4 ms
    Rig g(c);
    CHECK(g.drv.init(g.now()) && g.dev.r[reg::CFG_REG] == (CFG_P_SHIFT | CFG_T_SHIFT), "T_SHIFT");
    double we = 0;
    for (int i = 0; i < 10; i++) if (g.step(P0, -20.0) == Update::NEW_SAMPLE) we = std::fmax(we, std::fabs(g.drv.last().temperature_c + 20.0));
    CHECK(we < 0.01, "32x temperature err %f", we);
    // what a missing fix costs on an affected part
    SimDps310 d2; d2.now = 200000; d2.write(reg::CFG_REG, 4); d2.write(reg::PRS_CFG, 0x54);
    d2.write(reg::TMP_CFG, 0xA0); d2.write(reg::MEAS_CFG, 7);
    d2.produce(P0, T0);
    float p, t;
    compensate(known_coefs(), raw24(&d2.r[0]), raw24(&d2.r[3]), 253952, 524288, p, t);
    std::printf("      without the fix the model part reads %.1f C, %.0f Pa (true 25.0 C, 101325 Pa)\n", double(t), double(p));
    CHECK(std::fabs(t - 50.0f) < 0.1f, "model defect");
}

static void test_coefficients()
{
    std::printf("T6 coefficient integrity: dual read, sliding window, never use corrupt data\n");
    const Coefficients truth = known_coefs();
    int ok = 0, used_bad = 0;
    for (uint8_t byte = 0; byte < 18; byte++) {
        for (uint8_t bit = 0; bit < 8; bit++) {
            for (uint32_t occ = 1; occ <= 2; occ++) {
                Rig g;
                g.bus.add_flip(true, reg::COEF, occ, byte, bit);
                if (g.drv.init(g.now())) ok++;
                if (g.drv.coefficients() != truth && (g.drv.health().flags & F_COEF_VALID)) used_bad++;
            }
        }
    }
    CHECK(ok == 288 && used_bad == 0, "single flip: %d/288 init OK, %d used corrupt", ok, used_bad);
    std::printf("      288 single-bit flips (18 B x 8 b x read 1|2): %d inits OK, %d corrupt sets used\n", ok, used_bad);
    {   // every read corrupted at a different place: must never validate
        Rig g;
        for (uint32_t occ = 1; occ <= 40; occ++) g.bus.add_flip(true, reg::COEF, occ, uint8_t(occ % 18), uint8_t(occ % 8));
        const bool r = g.drv.init(g.now());
        int samples = 0;
        for (int i = 0; i < 5; i++) if (g.step(P0, T0) == Update::NEW_SAMPLE) samples++;
        CHECK(!r && !(g.drv.health().flags & F_COEF_VALID) && samples == 0, "persistent corruption must not validate");
        std::printf("      persistent corruption: init refused, %u mismatches, 0 samples\n", unsigned(g.drv.health().coef_mismatch));
    }
    {   // floating bus: identical all-0xFF twice -> sanity
        Rig g;
        std::memset(&g.dev.r[reg::COEF], 0xFF, 18);
        CHECK(!g.drv.init(g.now()) && g.drv.health().coef_insane >= 1, "all-0xFF block rejected");
        Rig g2;
        std::memset(&g2.dev.r[reg::COEF], 0x00, 18);
        CHECK(!g2.drv.init(g2.now()) && g2.drv.health().coef_insane >= 1, "all-0x00 block rejected");
    }
    {   // COEF_RDY never set
        Rig g;
        g.dev.boot_until = ~uint64_t(0) >> 1;
        CHECK(!g.drv.init(g.now()) && g.drv.health().coef_not_ready == 1, "COEF_RDY gate");
    }
    {   // register pointer slips once (0x10 -> 0x11 etc.) during the coefficient read
        Rig g;
        g.bus.addr_once_reg = reg::COEF;
        g.bus.addr_once_xor = 0x01;          // reads 0x11..0x22: block shifted by one byte
        CHECK(g.drv.init(g.now()) && g.drv.coefficients() == truth && g.bus.addr_once_used, "recovers after slip");
        std::printf("      register-pointer slip 0x10 -> 0x11 on one read: mismatch detected, true block used\n");
    }
    {   // re-verify after recovery: NVM image changed under us -> refuse
        Rig g;
        CHECK(g.drv.init(g.now()), "init");
        Coefficients alt = truth; alt.c10 += 1;
        encode_coefficients(alt, &g.dev.r[reg::COEF]);
        g.bus.nack_burst = 9;
        int samples = 0;
        for (int i = 0; i < 10; i++) if (g.step(P0, T0) == Update::NEW_SAMPLE) samples++;
        CHECK((g.drv.health().flags & F_COEF_CHANGED) && g.drv.coefficients() == truth && samples == 0,
              "changed coefficients after recovery must not be adopted");
    }
    // ArduPilot fragility: single read, no validation -> silent error
    double worst = 0, smallest = 1e9;
    int silent = 0;
    for (uint8_t byte = 0; byte < 18; byte++) {
        for (uint8_t bit = 0; bit < 8; bit++) {
            uint8_t blk[18];
            encode_coefficients(truth, blk);
            const int32_t traw = inv_t(truth, T0, 253952);
            const int32_t praw = inv_p(truth, P0, double(traw) / 253952, 253952);
            blk[byte] = uint8_t(blk[byte] ^ (1u << bit));
            float p, t;
            ap_calculate_PT(ap_parse(blk), traw, praw, p, t);
            const double e = std::fabs(double(p) - P0);
            worst = std::fmax(worst, e);
            smallest = std::fmin(smallest, e);
            if (e > 1.0 && e < 3000.0 && std::fabs(t) < 120) silent++;
        }
    }
    std::printf("      ArduPilot single read + one flip: P error %.2f .. %.0f Pa; %d/144 cases 1..3000 Pa\n"
                "      (passes its 120 C health check, would be baked in until reboot)\n", smallest, worst, silent);
    CHECK(silent > 0, "demonstration");
}

static void test_config_loss()
{
    std::printf("T7 config loss: sensor POR mid-flight, register upset, write corruption\n");
    {
        Rig g;
        CHECK(g.drv.init(g.now()), "init");
        int bad = 0, n = 0, after = 0, gap = 0;
        bool lost = false;
        for (int i = 0; i < 120; i++) {
            if (i == 50) { g.dev.por(); lost = true; }
            const Update u = g.step(P0, T0);
            if (u == Update::NEW_SAMPLE) {
                n++;
                if (std::fabs(g.drv.last().pressure_pa - P0) > 0.5) bad++;
                if (lost) { after++; }
            } else if (lost && after == 0) {
                gap++;
            }
        }
        const Health& h = g.drv.health();
        CHECK(h.config_lost == 1 && h.config_repairs == 1, "lost=%u repairs=%u", unsigned(h.config_lost), unsigned(h.config_repairs));
        CHECK(g.dev.fix_applied && (g.dev.r[reg::MEAS_CFG] & 7) == 7 && g.dev.r[reg::PRS_CFG] == 0x54, "repaired");
        CHECK(bad == 0 && after > 60, "bad=%d after=%d", bad, after);
        std::printf("      POR at sample 50: detected by next poll, repaired, outage %d samples, %d bad accepted\n", gap, bad);
    }
    {   // register upset: PRS_CFG oversampling changes to 2x (kP mismatch)
        Rig g;
        CHECK(g.drv.init(g.now()), "init");
        int bad = 0;
        for (int i = 0; i < 60; i++) {
            if (i == 20) g.dev.r[reg::PRS_CFG] = 0x51;
            if (g.step(P0, T0) == Update::NEW_SAMPLE && std::fabs(g.drv.last().pressure_pa - P0) > 0.5) bad++;
        }
        CHECK(g.drv.health().config_lost == 1 && g.dev.r[reg::PRS_CFG] == 0x54 && bad == 0,
              "upset lost=%u bad=%d", unsigned(g.drv.health().config_lost), bad);
    }
    {   // SDA flip while writing PRS_CFG / CFG_REG at init
        for (uint8_t bit = 0; bit < 8; bit++) {
            Rig g;
            g.bus.add_flip(false, reg::PRS_CFG, 1, 0, bit);
            g.bus.add_flip(false, reg::CFG_REG, 1, 0, uint8_t(7 - bit));
            const bool r = g.drv.init(g.now());
            CHECK(r && g.dev.r[reg::PRS_CFG] == 0x54 && g.dev.r[reg::CFG_REG] == CFG_P_SHIFT &&
                  g.drv.health().config_readback_fail >= 1, "write flip bit %u", bit);
        }
        std::printf("      write-data flips on PRS_CFG/CFG_REG: caught by read-back and rewritten (8/8)\n");
    }
    {   // a flipped status poll must NOT trigger a reconfiguration
        Rig g;
        CHECK(g.drv.init(g.now()), "init");
        const uint32_t w0 = g.drv.health().config_writes;
        g.bus.add_flip(true, reg::PRS_CFG, g.bus.read_occ[reg::PRS_CFG] + 2, 1, 3);
        for (int i = 0; i < 5; i++) g.step(P0, T0);
        CHECK(g.drv.health().config_lost == 0 && g.drv.health().config_writes == w0, "poll flip confirmed false");
    }
}

static void test_nack()
{
    std::printf("T8 NACK bursts / arbitration loss: retry absorbs, threshold -> recovery\n");
    {
        Rig g;
        CHECK(g.drv.init(g.now()), "init");
        g.step(P0, T0); g.step(P0, T0); g.step(P0, T0);
        g.bus.nack_burst = 2;
        const Update u = g.step(P0, T0);
        CHECK(u == Update::NEW_SAMPLE && g.drv.health().xfer_failed == 0 && g.drv.health().retries == 2,
              "burst 2: %s failed=%u", to_string(u), unsigned(g.drv.health().xfer_failed));
    }
    {
        Rig g;
        CHECK(g.drv.init(g.now()), "init");
        for (int i = 0; i < 5; i++) g.step(P0, T0);
        g.bus.nack_burst = 9;      // 3 transactions x 3 attempts
        int first_ok = -1;
        for (int i = 0; i < 20 && first_ok < 0; i++) if (g.step(P0, T0) == Update::NEW_SAMPLE) first_ok = i;
        const Health& h = g.drv.health();
        CHECK(h.recoveries == 1 && h.inits == 2 && first_ok >= 0 && first_ok <= 3, "rec=%u inits=%u first=%d",
              unsigned(h.recoveries), unsigned(h.inits), first_ok);
        std::printf("      burst 9: %u failed xfers -> %u recovery (%u clocks, SDA high), re-init, samples back after %d\n",
                    unsigned(h.xfer_failed), unsigned(h.recoveries), unsigned(h.last_clear_clocks), first_ok + 1);
    }
}

static void test_stuck()
{
    std::printf("T9 SDA stuck low: <=9 clocks while watching SDA, STOP, re-init\n");
    int good = 0;
    for (uint32_t k = 1; k <= 9; k++) {
        Rig g;
        CHECK(g.drv.init(g.now()), "init");
        for (int i = 0; i < 4; i++) g.step(P0, T0);
        g.bus.stuck_clocks = k;
        const uint32_t pulses0 = g.bus.clock_pulses, stops0 = g.bus.stops;
        int first_ok = -1;
        for (int i = 0; i < 10 && first_ok < 0; i++) if (g.step(P0, T0) == Update::NEW_SAMPLE) first_ok = i;
        const Health& h = g.drv.health();
        const bool ok = h.recoveries == 1 && h.last_clear_clocks == k && g.bus.clock_pulses - pulses0 == k &&
                        g.bus.stops - stops0 == 1 && first_ok >= 0 && first_ok <= 2 && h.sda_stuck_seen >= 1;
        CHECK(ok, "k=%u rec=%u clocks=%u pulses=%u stops=%u first=%d", unsigned(k), unsigned(h.recoveries),
              unsigned(h.last_clear_clocks), unsigned(g.bus.clock_pulses - pulses0), unsigned(g.bus.stops - stops0), first_ok);
        if (ok) good++;
    }
    std::printf("      k = 1..9 held clocks: %d/9 cleared with exactly k pulses, STOP on SDA with SCL high, 1 STOP each\n", good);
    {   // hard stuck: 9 clocks, fail, holdoff, then heals
        Rig g;
        CHECK(g.drv.init(g.now()), "init");
        g.bus.stuck_clocks = 2000000;
        int nr = 0;
        for (int i = 0; i < 8; i++) if (g.step(P0, T0) != Update::NEW_SAMPLE) nr++;
        const Health& h = g.drv.health();
        CHECK(h.recovery_failed >= 1 && h.last_clear_clocks == 9 && (h.flags & F_RECOVERY_FAIL) && nr == 8,
              "hard stuck failed=%u clocks=%u", unsigned(h.recovery_failed), unsigned(h.last_clear_clocks));
        CHECK(g.drv.state() == DriverState::HOLDOFF, "holdoff");
        const uint32_t attempts = h.recoveries;
        g.bus.stuck_clocks = 0;   // e.g. GPS cable unplugged / compass power-cycled
        int first_ok = -1;
        for (int i = 0; i < 12 && first_ok < 0; i++) if (g.step(P0, T0) == Update::NEW_SAMPLE) first_ok = i;
        CHECK(first_ok >= 0 && !(g.drv.health().flags & F_RECOVERY_FAIL), "heals after holdoff");
        std::printf("      hard stuck: 9 clocks, %u failed recoveries in 250 ms (holdoff), healed %d samples after release\n",
                    unsigned(attempts), first_ok + 1);
    }
}

// The pre-Rev-12 bus clear, kept verbatim as a simulator sensitivity check:
// stop clocking at the first SDA high, then STOP via SCL low / SDA low / SCL
// high / SDA high.
static bool legacy_recover(I2cBusGpio& g, uint32_t& clocks)
{
    const uint32_t hp = 5;
    g.begin_bitbang();
    g.set_sda(true); g.set_scl(true); g.delay_us(hp);
    bool ok = g.read_scl();
    clocks = 0;
    while (ok && !g.read_sda() && clocks < 9) {
        g.set_scl(false); g.delay_us(hp); g.set_scl(true); ok = g.read_scl(); g.delay_us(hp); clocks++;
    }
    if (ok) {
        g.set_scl(false); g.delay_us(hp); g.set_sda(false); g.delay_us(hp);
        g.set_scl(true); ok = g.read_scl(); g.delay_us(hp); g.set_sda(true); g.delay_us(hp);
        ok = ok && g.read_sda() && g.read_scl();
    }
    g.end_bitbang();
    return ok;
}

static void test_stuck_bitlevel()
{
    std::printf("T9b bus clear vs a bit-level slave hung mid-READ / mid-WRITE ACK / mid-address\n");
    static const char* const names[4] = {"", "read (slave TX)", "write (slave RX)", "address (after START)"};
    {   // the reproduced field failure: remaining bits 0,0,1,0
        Rig g;
        g.bus.hang(BitSlave::TX, 4, 0x02, true, false);
        uint32_t clk = 0;
        const uint32_t st0 = g.bus.stops;
        const bool r = legacy_recover(g.bus, clk);
        CHECK(!r && clk == 2 && g.bus.stops - st0 == 0 && g.bus.bs.in_txn,
              "legacy repro r=%d clocks=%u stops=%u", int(r), unsigned(clk), unsigned(g.bus.stops - st0));
        g.bus.hang(BitSlave::TX, 4, 0x02, true, false);
        const uint32_t p0 = g.bus.clock_pulses, s0 = g.bus.stops;
        const bool n = g.drv.recover_bus();
        CHECK(n && g.drv.health().last_clear_clocks == 2 && g.bus.clock_pulses - p0 == 2 && g.bus.stops - s0 == 1 &&
              !g.bus.bs.in_txn && g.bus.bs.mode == BitSlave::IDLE, "new repro");
        std::printf("      bits 0,0,1,0 left (TX pos 4, 0x02): legacy %s after %u clocks, %u STOP; new %s, %u clocks, 1 STOP\n",
                    r ? "OK" : "FAILS", unsigned(clk), unsigned(g.bus.stops - st0 > 0), n ? "OK" : "FAIL",
                    unsigned(g.drv.health().last_clear_clocks));
    }
    Rig g;
    uint32_t cases = 0, good = 0, legacy_fail = 0, worst[4] = {0, 0, 0, 0}, n_mode[4] = {0, 0, 0, 0};
    uint32_t total_clocks = 0;
    for (int m = BitSlave::TX; m <= BitSlave::ADDR; m++) {
        const BitSlave::Mode mode = BitSlave::Mode(m);
        for (uint8_t pos = 0; pos <= 8; pos++) {
            for (unsigned b = 0; b < 256; b++) {
                for (int scl_low = 0; scl_low < 2; scl_low++) {
                    // the master can only have been driving SDA low in its own read-ACK slot
                    const int msda_n = (mode == BitSlave::TX && pos == 8) ? 2 : 1;
                    for (int msda = 0; msda < msda_n; msda++) {
                        cases++;
                        n_mode[m]++;
                        g.bus.hang(mode, pos, uint8_t(b), scl_low != 0, msda != 0);
                        const uint32_t p0 = g.bus.clock_pulses, s0 = g.bus.stops;
                        const bool r = g.drv.recover_bus();
                        const uint32_t clk = g.drv.health().last_clear_clocks, pulses = g.bus.clock_pulses - p0;
                        const bool ok = r && clk <= 9 && pulses == clk && g.bus.stops - s0 >= 1 &&
                                        !g.bus.bs.in_txn && g.bus.bs.mode == BitSlave::IDLE &&
                                        g.bus.read_sda() && g.bus.read_scl() &&
                                        !(g.drv.health().flags & F_RECOVERY_FAIL);
                        if (ok) good++;
                        else if (good + 50 > cases)   // print only the first few
                            CHECK(false, "%s pos=%u byte=0x%02X scl_low=%d msda=%d r=%d clocks=%u pulses=%u stops=%u in_txn=%d",
                                  names[m], unsigned(pos), b, scl_low, msda, int(r), unsigned(clk), unsigned(pulses),
                                  unsigned(g.bus.stops - s0), int(g.bus.bs.in_txn));
                        if (clk > worst[m]) worst[m] = clk;
                        total_clocks += clk;
                        // same state through the pre-Rev-12 sequence
                        g.bus.hang(mode, pos, uint8_t(b), scl_low != 0, msda != 0);
                        uint32_t lc = 0;
                        const bool lr = legacy_recover(g.bus, lc);
                        if (!lr || g.bus.bs.in_txn) legacy_fail++;
                    }
                }
            }
        }
    }
    CHECK(good == cases, "bit-level recovery %u/%u", unsigned(good), unsigned(cases));
    CHECK(worst[BitSlave::TX] == 8 && worst[BitSlave::RX] == 1 && worst[BitSlave::ADDR] == 1,
          "worst clocks TX %u RX %u ADDR %u", unsigned(worst[1]), unsigned(worst[2]), unsigned(worst[3]));
    CHECK(legacy_fail > 0, "simulator must expose the pre-Rev-12 STOP bug");
    for (int m = BitSlave::TX; m <= BitSlave::ADDR; m++)
        std::printf("      %-22s %5u states (pos 0..8 x 256 bytes x SCL low/high%s): worst %u clocks\n", names[m],
                    unsigned(n_mode[m]), m == BitSlave::TX ? " x master ACK" : "", unsigned(worst[m]));
    std::printf("      %u/%u recovered, STOP seen by slave, bus idle, <= 9 clocks (mean %.2f); legacy sequence fails %u/%u\n",
                unsigned(good), unsigned(cases), double(total_clocks) / cases, unsigned(legacy_fail), unsigned(cases));
}

static void test_spikes()
{
    std::printf("T10 plausibility: range, isolated spikes, real 3 m step, 30 m/s climb\n");
    Rig g;
    CHECK(g.drv.init(g.now()), "init");
    double P = P0;
    for (int i = 0; i < 10; i++) g.step(P + 0.5 * nrand(), T0);
    // isolated corrupted samples: flip one bit in the PSR burst (bits 6..23 of the 24-bit word)
    int injected = 0, leaked = 0, small_leak = 0;
    for (int i = 0; i < 400; i++) {
        const bool inj = (i % 7) == 3;
        if (inj) {
            const uint32_t bitpos = 6 + irand(18);   // 0..23 from LSB
            g.bus.add_flip(true, reg::PSR_B2, g.bus.read_occ[reg::PSR_B2] + 1, uint8_t(2 - bitpos / 8), uint8_t(bitpos % 8));
            injected++;
        }
        const double pt = P + 0.5 * nrand();
        if (g.step(pt, T0) == Update::NEW_SAMPLE && inj) {
            const double e = std::fabs(g.drv.last().pressure_pa - pt);
            if (e > 31.0) leaked++; else small_leak++;
        }
        if (g.bus.nflips > 48) g.bus.clear_flips();
    }
    const Health& h = g.drv.health();
    std::printf("      %d corrupted samples: %d accepted with error > gate, %d accepted below gate (bits 6-7 of LSB)\n",
                injected, leaked, small_leak);
    CHECK(leaked == 0, "leaked %d", leaked);
    // real 3 m climb as a step (-36 Pa)
    const double step = -3.0 * 12.01;
    P += step;
    int follow = -1;
    for (int i = 0; i < 10 && follow < 0; i++) {
        if (g.step(P + 0.5 * nrand(), T0) == Update::NEW_SAMPLE && std::fabs(g.drv.last().pressure_pa - P) < 3) follow = i + 1;
    }
    CHECK(follow >= 1 && follow <= g.cfg.reanchor_samples, "3 m step followed in %d samples", follow);
    std::printf("      3 m step (%.1f Pa): followed after %d samples (%.0f ms), reanchors=%u\n", step, follow,
                follow * 31.25, unsigned(h.reanchors));
    // a 10 m step (120 Pa) is outside even the widened gate: only the re-anchor rule can follow it
    const uint32_t ra0 = h.reanchors;
    P -= 10.0 * 12.01;
    follow = -1;
    for (int i = 0; i < 10 && follow < 0; i++) if (g.step(P + 0.5 * nrand(), T0) == Update::NEW_SAMPLE && std::fabs(g.drv.last().pressure_pa - P) < 3) follow = i + 1;
    CHECK(follow == g.cfg.reanchor_samples && h.reanchors == ra0 + 1, "10 m step followed in %d", follow);
    std::printf("      10 m step (%.0f Pa): re-anchored after %d consistent samples (%.0f ms)\n", -10 * 12.01, follow, follow * 31.25);
    // a spike immediately before a real step must not latch the filter out
    g.bus.add_flip(true, reg::PSR_B2, g.bus.read_occ[reg::PSR_B2] + 1, 0, 3);
    g.step(P, T0);
    P -= 36.0;
    follow = -1;
    for (int i = 0; i < 10 && follow < 0; i++) if (g.step(P + 0.5 * nrand(), T0) == Update::NEW_SAMPLE && std::fabs(g.drv.last().pressure_pa - P) < 3) follow = i + 1;
    CHECK(follow >= 1 && follow <= g.cfg.reanchor_samples, "spike+step followed in %d", follow);
    // sustained 30 m/s climb: every sample accepted
    const uint32_t rej0 = h.rej_rate;
    int acc = 0;
    for (int i = 0; i < 64; i++) {
        P -= 30.0 * 12.01 * 0.03125;
        if (g.step(P + 0.5 * nrand(), T0) == Update::NEW_SAMPLE) acc++;
    }
    CHECK(acc == 64 && h.rej_rate == rej0, "30 m/s climb acc=%d rej=%u", acc, unsigned(h.rej_rate - rej0));
    std::printf("      30 m/s climb for 2 s: %d/64 accepted, 0 rate rejections\n", acc);
    // range limits
    Rig r2;
    CHECK(r2.drv.init(r2.now()), "init");
    for (int i = 0; i < 5; i++) r2.step(P0, T0);
    const Update lo = r2.step(29000.0, T0);
    const Update hi = r2.step(121000.0, T0);
    CHECK(lo == Update::REJECTED && hi == Update::REJECTED && r2.drv.health().rej_range_p == 2, "range");
    r2.dev.r[reg::PSR_B2] = 0;
    r2.step(P0, 95.0);
    CHECK(r2.drv.health().rej_range_t == 1, "temperature range");
}

static void test_soak()
{
    std::printf("T11 soak: 20000 samples, random SDA noise + NACK/ARB/BERR + stuck + POR\n");
    Rig g;
    g.bus.ber = 2e-4;  g.bus.p_nack = 0.01; g.bus.p_arb = 0.003; g.bus.p_berr = 0.003;
    g.bus.p_addr = 0.002; g.bus.p_stuck = 0.0005; g.bus.p_por = 0.0002;
    g.drv.init(g.now());
    double P = P0, v = 0, worst = 0;
    int acc = 0, over2 = 0, coef_bad = 0;
    for (int i = 0; i < 20000; i++) {
        v += 0.3 * nrand();
        if (v > 10) v = 10;
        if (v < -10) v = -10;
        P -= v * 12.01 * 0.03125;
        if (P < 90000 || P > 105000) v = -v;
        const double pt = P + 0.5 * nrand();
        if (g.step(pt, T0) == Update::NEW_SAMPLE) {
            acc++;
            const double e = std::fabs(g.drv.last().pressure_pa - pt);
            worst = std::fmax(worst, e);
            if (e > 2.0) over2++;
        }
        if ((g.drv.health().flags & F_COEF_VALID) && g.drv.coefficients() != known_coefs()) coef_bad++;
    }
    const Health& h = g.drv.health();
    std::printf("      faults: %u bit flips, %u stuck events (%u bit-level), %u POR; xfer ok %u, NACK %u, ARB %u, BERR %u, TO %u, retries %u\n",
                unsigned(g.bus.rnd_flips), unsigned(g.bus.rnd_stuck), unsigned(g.bus.rnd_bit_hangs), unsigned(g.bus.rnd_por), unsigned(h.xfer_ok),
                unsigned(h.nack), unsigned(h.arb_lost), unsigned(h.bus_error), unsigned(h.timeout), unsigned(h.retries));
    std::printf("      recoveries %u (failed %u), config lost/repaired %u/%u, coef mismatches %u, rejections rate/range/pattern %u/%u/%u\n",
                unsigned(h.recoveries), unsigned(h.recovery_failed), unsigned(h.config_lost), unsigned(h.config_repairs),
                unsigned(h.coef_mismatch), unsigned(h.rej_rate), unsigned(h.rej_range_p + h.rej_range_t), unsigned(h.rej_pattern));
    std::printf("      accepted %d/20000 (%.2f %%), worst |error| %.1f Pa, %d (%.3f %%) > 2 Pa\n", acc, acc / 200.0, worst,
                over2, over2 * 100.0 / (acc ? acc : 1));
    CHECK(coef_bad == 0, "coefficients corrupted %d", coef_bad);
    CHECK(acc > 18000, "availability %d", acc);
    CHECK(worst < 40.0, "worst %f", worst);
    CHECK(over2 * 100.0 / (acc ? acc : 1) < 1.0, "over2 %d", over2);
    CHECK(h.recoveries >= g.bus.rnd_stuck && g.bus.rnd_stuck > 0, "every stuck event recovered");
    CHECK(g.bus.rnd_bit_hangs > 0 && !g.bus.bs.in_txn, "bit-level hangs %u cleared", unsigned(g.bus.rnd_bit_hangs));
}

int main()
{
    std::printf("Nano H743 AIO DPS310 robust driver tests (Rev 12.0)\n");
    test_bits();
    test_scale_budget();
    test_compensation();
    test_probe();
    test_init_sequence();
    test_coefficients();
    test_config_loss();
    test_nack();
    test_stuck();
    test_stuck_bitlevel();
    test_spikes();
    test_soak();
    std::printf("\nRESULT: %s (%d checks, %d failures)\n", g_fail ? "FAIL" : "PASS", g_pass + g_fail, g_fail);
    return g_fail ? 1 : 0;
}
